## gateway/board/atk-dlrk3588-ili9488.its
```
/dts-v1/;

/ {
	 description = "ATK-DLRK3588 boot image with SPI0 ILI9488 spidev";
	 #address-cells = <1>;

	 images {
		 fdt {
			 description = "ATK-DLRK3588 device tree";
			 data = /incbin/("fdt.spi.dtb");
			 type = "flat_dt";
			 arch = "arm64";
			 compression = "none";
			 load = <0xffffff00>;
			 hash-1 {
				 algo = "sha256";
			 };
		 };

		 kernel {
			 description = "ATK-DLRK3588 Linux kernel";
			 data = /incbin/("kernel.img");
			 type = "kernel";
			 arch = "arm64";
			 os = "linux";
			 compression = "none";
			 load = <0xffffff01>;
			 entry = <0xffffff01>;
			 hash-1 {
				 algo = "sha256";
			 };
		 };

		 resource {
			 description = "ATK-DLRK3588 resource image";
			 data = /incbin/("resource.img");
			 type = "multi";
			 arch = "arm64";
			 compression = "none";
			 hash-1 {
				 algo = "sha256";
			 };
		 };
	 };

	 configurations {
		 default = "conf";
		 conf {
			 kernel = "kernel";
			 fdt = "fdt";
			 multi = "resource";
		 };
	 };
};
```
